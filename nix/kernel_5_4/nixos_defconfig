## nix/kernel_5_4/nixos_defconfig
```kconfig
# needed for nixos
CONFIG_CGROUPS=y
CONFIG_FHANDLE=y
CONFIG_CRYPTO_USER_API_HASH=y
CONFIG_DMIID=y
CONFIG_AUTOFS_FS=y
CONFIG_SECCOMP=y
CONFIG_BLK_DEV_INITRD=y
CONFIG_DECOMPRESS_LZMA=y
CONFIG_KERNEL_LZMA=y

# namespaces
CONFIG_NAMESPACES=y           # Master switch for namespaces
CONFIG_UTS_NS=y               # UTS (hostname/domainname) namespace
CONFIG_IPC_NS=y               # IPC namespace
CONFIG_USER_NS=y              # User namespace (required for unprivileged containers)
CONFIG_PID_NS=y               # PID namespace
CONFIG_NET_NS=y               # Network namespace
CONFIG_CGROUP_NS=y            # Cgroup namespace

# internet (crashes wifi driver)
# CONFIG_IPV6=y

# ACL (needed by udev)
CONFIG_EXT4_FS_POSIX_ACL=y
CONFIG_EXT3_FS_POSIX_ACL=y
CONFIG_EXT2_FS_POSIX_ACL=y
CONFIG_TMPFS_POSIX_ACL=y

# systemd
CONFIG_AUTOFS4_FS=y

# # firewall
# CONFIG_NF_TABLES=y
# CONFIG_NF_TABLES_INET=y         # For mixed IPv4/IPv6 tables (e.g., iptables -t filter)
# CONFIG_NFT_CHAIN_ROUTE_IPV4=y
# CONFIG_NFT_CHAIN_ROUTE_IPV6=y
# CONFIG_NFT_REJECT=y
# CONFIG_NFT_REJECT_INET=y
# CONFIG_NFT_MASQ=y
# CONFIG_NFT_NAT=y
# CONFIG_NFT_LOG=y
# CONFIG_NFT_COUNTER=y
# CONFIG_NETFILTER_XTABLES_COMPAT=y   # Needed for legacy iptables compatibility
# CONFIG_NETFILTER=y

# enable /proc/config.gz
CONFIG_IKCONFIG=y
CONFIG_IKCONFIG_PROC=y

# # for qemu
# CONFIG_VIRTIO=y
# CONFIG_VIRTIO_PCI=y
# CONFIG_VIRTIO_MMIO=y
# CONFIG_VIRTIO_BLK=y
# CONFIG_VIRTIO_NET=y
# CONFIG_PCI=y
# CONFIG_PCI_HOST_GENERIC=y
# CONFIG_PCI_SYSCALL=y
# CONFIG_ARM_PSCI_FW=y
# CONFIG_SUN4I_EMAC=y
# CONFIG_PHYLIB=y
# CONFIG_FIXED_PHY=y
# CONFIG_MDIO_BUS=y
# CONFIG_MDIO_SUN4I=y
# CONFIG_REALTEK_PHY=y
# CONFIG_SMSC_PHY=y
# CONFIG_GENERIC_PHY=y

# increase dmesg buffer size
CONFIG_LOG_BUF_SHIFT=18
```

## nix/rootfs/hdzgoggle_rootfs_defconfig
```kconfig
BR2_arm=y
BR2_cortex_a7=y
BR2_ARM_FPU_NEON=y

# toolchain
BR2_TOOLCHAIN_EXTERNAL=y
BR2_TOOLCHAIN_EXTERNAL_CUSTOM=y
BR2_TOOLCHAIN_EXTERNAL_DOWNLOAD=y
BR2_TOOLCHAIN_EXTERNAL_URL="https://toolchains.bootlin.com/downloads/releases/toolchains/armv7-eabihf/tarballs/armv7-eabihf--musl--stable-2018.02-2.tar.bz2"
BR2_TOOLCHAIN_EXTERNAL_CUSTOM_PREFIX="arm-buildroot-linux-musleabihf"
BR2_TOOLCHAIN_EXTERNAL_REL_BIN_PATH="bin"
BR2_TOOLCHAIN_EXTERNAL_GCC_6=y
BR2_TOOLCHAIN_EXTERNAL_HEADERS_4_1=y
BR2_TOOLCHAIN_EXTERNAL_CUSTOM_MUSL=y
BR2_TOOLCHAIN_EXTERNAL_CXX=y
BR2_TOOLCHAIN_EXTERNAL_GDB_SERVER_COPY=y

BR2_TARGET_GENERIC_HOSTNAME="hdzgoggle"
BR2_TARGET_GENERIC_ROOT_PASSWD="hdzgoggle"

BR2_ENABLE_DEBUG=y
BR2_ENABLE_RUNTIME_DEBUG=y

#
BR2_KERNEL_HEADERS_4_9=y
BR2_KERNEL_HEADERS_CUSTOM_TARBALL=y
BR2_KERNEL_HEADERS_CUSTOM_TARBALL_LOCATION=

#packages
BR2_PER_PACKAGE_DIRECTORIES=y
BR2_ROOTFS_DEVICE_CREATION_DYNAMIC_MDEV=y
BR2_PACKAGE_BASH=n
BR2_PACKAGE_BUSYBOX_INDIVIDUAL_BINARIES=y
BR2_PACKAGE_BUSYBOX_SHOW_OTHERS=y
BR2_PACKAGE_GDB_SERVER=n
BR2_PACKAGE_HAVEGED=y
BR2_PACKAGE_HDZGOGGLE=y
BR2_PACKAGE_IW=y
BR2_PACKAGE_LINUX_TOOLS_GPIO=y
BR2_PACKAGE_NANO=n
BR2_PACKAGE_HTOP=n
BR2_PACKAGE_OPENSSH=n
BR2_PACKAGE_WPA_SUPPLICANT=y
BR2_PACKAGE_WPA_SUPPLICANT_AUTOSCAN=y
BR2_PACKAGE_WPA_SUPPLICANT_CLI=y
BR2_PACKAGE_WPA_SUPPLICANT_WPA_CLIENT_SO=y
BR2_PACKAGE_WPA_SUPPLICANT_CTRL_IFACE=y
BR2_PACKAGE_MTD=y
# BR2_PACKAGE_MTD_UBIHEALTHD is not set
BR2_PACKAGE_MTD_JFFS_UTILS=y
BR2_PACKAGE_MTD_MKFSJFFS2=y
BR2_PACKAGE_DOSFSTOOLS=y
BR2_PACKAGE_DOSFSTOOLS_FATLABEL=y
BR2_PACKAGE_DOSFSTOOLS_FSCK_FAT=y
BR2_PACKAGE_DOSFSTOOLS_MKFS_FAT=y
BR2_PACKAGE_EXFAT_UTILS=y

# rootfs config
BR2_TARGET_ROOTFS_EXT2=y
BR2_TARGET_ROOTFS_EXT2_4=y
BR2_TARGET_ROOTFS_EXT2_SIZE="512M"
# BR2_TARGET_ROOTFS_TAR is not set

BR2_ROOTFS_OVERLAY="$(BR2_EXTERNAL_HDZGOGGLE_PATH)/board/hdzgoggle_common/rootfs_overlay"
BR2_ROOTFS_POST_BUILD_SCRIPT="$(BR2_EXTERNAL_HDZGOGGLE_PATH)/board/hdzgoggle_common/post-build.sh $(BR2_EXTERNAL_HDZGOGGLE_PATH)/board/hdzgoggle_sdcard/post-build.sh"
BR2_ROOTFS_POST_IMAGE_SCRIPT="$(BR2_EXTERNAL_HDZGOGGLE_PATH)/board/hdzgoggle_common/post-image.sh"
```
